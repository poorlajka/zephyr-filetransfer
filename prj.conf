## CMakeLists.txt
```
# SPDX-License-Identifier: Apache-2.0

cmake_minimum_required(VERSION 3.20.0)
find_package(Zephyr REQUIRED HINTS $ENV{ZEPHYR_BASE})
project(zaag)

FILE(GLOB app_sources  src/*.c)

target_sources(app PRIVATE
    ${app_sources}
)
```

## prj.conf
```kconfig
CONFIG_MAIN_STACK_SIZE=2048

# Let __ASSERT do its job
CONFIG_DEBUG=y

CONFIG_LOG=y
CONFIG_LOG_MODE_MINIMAL=y

CONFIG_FLASH=y
CONFIG_FLASH_MAP=y
CONFIG_FLASH_PAGE_LAYOUT=y

CONFIG_FILE_SYSTEM=y
CONFIG_FILE_SYSTEM_LITTLEFS=y


CONFIG_BT=y
#CONFIG_BT_SETTINGS=y

#CONFIG_BT_DEBUG_LOG=y
#CONFIG_BT_SMP=y
CONFIG_BT_SIGNING=y
CONFIG_BT_PERIPHERAL=y
CONFIG_BT_DIS=y
CONFIG_BT_ATT_PREPARE_COUNT=5
CONFIG_BT_PRIVACY=y
CONFIG_BT_DEVICE_NAME="Zagreus bluetooth connect pliz"
CONFIG_BT_DEVICE_APPEARANCE=833
CONFIG_BT_DEVICE_NAME_DYNAMIC=y
CONFIG_BT_DEVICE_NAME_MAX=65

#CONFIG_PM_SINGLE_IMAGE=y
#CONFIG_PM_PARTITION_SIZE_LITTLEFS=0x6000


#ONFIG_BT_KEYS_OVERWRITE_OLDEST=y
#CONFIG_BT_SETTINGS=y
#CONFIG_FLASH=y
#CONFIG_FLASH_PAGE_LAYOUT=y
#CONFIG_FLASH_MAP=y
#CONFIG_NVS=y
#CONFIG_SETTINGS=y



CONFIG_HEAP_MEM_POOL_SIZE=8192
```

## src/main.c
```c
#include <zephyr/sys/printk.h>
#include <zephyr/kernel.h>
#include <zephyr/fs/fs.h>

#include "ble_setup.h"
#include "gatt_serv.h"
#include "file_sys.h"

/*
 * Hello there, the filetransfer was implemented using a null packet to signify
 * transmittion end, this is stupid since
 */

enum ServerState {
    Idle,
    TransferringData,
};

/*
 * Declaration and registration of GATT-service can be found in gatt_serv.h. 
 * void
 */
void main (void) {

    /* 
     * Setup bluetooth and filesys.
     */
    if (ble_setup_init()) {
        return;
    }
    if (ble_setup_start_advertising()) {
        return;
    }
    if (file_sys_init() < 0) {
        return;
    }

    /*
     * Uncomment these to create and remove example files for 
     * testing the filesystem. 
     */
    //file_sys_create_files();
    //file_sys_rm_files();
    lsdir("/lfs/sys_logs");

    /*
     * Server will simply wait for a client to request filedata,
     * upon which it will read data from disk and perform transfer to client.
     */
    enum ServerState server_state = Idle;
    while (true) {
        switch (server_state) {
            case Idle:
                if (gatt_serv_is_transfer_ready()) {

                    gatt_serv_load_transfer_data();

                    server_state = TransferringData;
                }
                k_sleep(K_MSEC(100));
                break;

            case TransferringData:
                if (gatt_serv_send_packet()) {
                    server_state = Idle;
                }
                break;
        }
    }
}
```

## src/ble_setup.c
```c
#include <zephyr/bluetooth/bluetooth.h>
#include <zephyr/bluetooth/conn.h>
#include <zephyr/bluetooth/uuid.h>
#include <zephyr/bluetooth/gatt.h>
#include <zephyr/bluetooth/hci.h>
#include <zephyr/sys/printk.h>

#define BT_UUID_CUSTOM_SERVICE_VAL \
	BT_UUID_128_ENCODE(0x00000001,0x1000,0x2000,0x3000,0x111122223333)

/* Bluetooth advertising data */
static const struct bt_data ad[] = {
    BT_DATA_BYTES(BT_DATA_FLAGS, (BT_LE_AD_GENERAL | BT_LE_AD_NO_BREDR)),
    BT_DATA_BYTES(BT_DATA_UUID16_ALL),
    BT_DATA_BYTES(BT_DATA_UUID128_ALL, BT_UUID_CUSTOM_SERVICE_VAL),
};

/* Bluetooth connection display callback */
static void auth_passkey_display (struct bt_conn *conn, unsigned int passkey) {
    char addr[BT_ADDR_LE_STR_LEN];

    bt_addr_le_to_str(bt_conn_get_dst(conn), addr, sizeof(addr));

    printk("Passkey for %s: %06u\n", addr, passkey);
    printk("\n");
}

/* Bluetooth connection authentication cancel callback */
static void auth_cancel (struct bt_conn *conn) {
    char addr[BT_ADDR_LE_STR_LEN];

    bt_addr_le_to_str(bt_conn_get_dst(conn), addr, sizeof(addr));

    printk("Pairing cancelled: %s\n", addr);
    printk("\n");
}

/*
static struct bt_conn_auth_cb auth_cb_display = {
    .passkey_display = auth_passkey_display,
    .passkey_entry = NULL,
    .cancel = auth_cancel,
};
*/


/* Bluetooth connected callback */
static void connected (struct bt_conn *conn, uint8_t err) {
    if (err) {
            printk("Connection failed (err %u)\n", err);
            return;
    }

    printk("Connected\n");
    printk("\n");
}

/* Bluetooth disconected callback */
static void disconnected (struct bt_conn *conn, uint8_t reason) {
    printk("Disconnected (reason %u)\n", reason);
    printk("\n");
}

BT_CONN_CB_DEFINE (conn_callbacks) = {
    .connected = connected,
    .disconnected = disconnected,
};


/* Gatt connection callback */
void mtu_updated (struct bt_conn *conn, uint16_t tx, uint16_t rx) {
    printk("Updated MTU: TX: %d RX: %d bytes\n", tx, rx);
    printk("\n");
}

static struct bt_gatt_cb gatt_callbacks = {
    .att_mtu_updated = mtu_updated
};

int ble_setup_init (void) {
    int err = 1;

    printk("Starting Bluetooth setup \n");
    printk("\n");

    
    err = bt_enable(NULL);
    if (err) {
        printk("Bluetooth init failed (err %d)\n", err);
        printk("\n");
        return err;
    }
    printk("Bluetooth initialized\n");
    printk("\n");
    bt_set_name("Buss sign");

    ble_setup_register_callbacks();

    return err;
}

int ble_setup_start_advertising (void) {
    int err;

    if (IS_ENABLED(CONFIG_SETTINGS)) {
        settings_load();
    }
    err = bt_le_adv_start(BT_LE_ADV_CONN_NAME, ad, ARRAY_SIZE(ad), NULL, 0);
    if (err) {
        printk("Advertising failed to start (err %d)\n", err);
        printk("\n");
        return err;
    }
    printk("Advertising successfully started\n");
    printk("\n");

    //settings_load();
    return err;
}

void ble_setup_register_callbacks (void) {
    bt_gatt_cb_register(&gatt_callbacks);
    //bt_conn_auth_cb_register(&auth_cb_display);
}
```

## src/ble_setup.h
```c
#ifndef BLE_SETUP_H
#define BLE_SETUP_H

int ble_setup_init (void);

int ble_setup_start_advertising (void);

#endif
```

## src/file_sys.c
```c
/*
 * Copyright (c) 2022 Lukasz Majewski, DENX Software Engineering GmbH
 * Copyright (c) 2019 Peter Bigot Consulting, LLC
 *
 * SPDX-License-Identifier: Apache-2.0
 */

/* Sample which uses the filesystem API with littlefs */

#include <stdio.h>

#include <zephyr/kernel.h>
#include <zephyr/device.h>
#include <zephyr/fs/fs.h>
#include <zephyr/fs/littlefs.h>
#include <zephyr/logging/log.h>
#include <zephyr/storage/flash_map.h>
#include <string.h>

#include "example_file_data.h"

LOG_MODULE_REGISTER(fs_main);

/* Matches LFS_NAME_MAX */
#define MAX_PATH_LEN 255
#define TEST_FILE_SIZE 547

static uint8_t file_test_pattern[TEST_FILE_SIZE];
int lsdir(const char *path)
{
	int res;
	struct fs_dir_t dirp;
	static struct fs_dirent entry;

	fs_dir_t_init(&dirp);

	/* Verify fs_opendir() */
	res = fs_opendir(&dirp, path);
	if (res) {
		LOG_ERR("Error opening dir %s [%d]\n", path, res);
		return res;
	}

	LOG_PRINTK("\nListing dir %s ...\n", path);
	for (;;) {
		/* Verify fs_readdir() */
		res = fs_readdir(&dirp, &entry);

		/* entry.name[0] == 0 means end-of-dir */
		if (res || entry.name[0] == 0) {
			if (res < 0) {
				LOG_ERR("Error reading dir [%d]\n", res);
			}
			break;
		}

		if (entry.type == FS_DIR_ENTRY_DIR) {
			LOG_PRINTK("[DIR ] %s\n", entry.name);
		} else {
			LOG_PRINTK("[FILE] %s (size = %zu)\n",
				   entry.name, entry.size);
		}
	}

	/* Verify fs_closedir() */
	fs_closedir(&dirp);

	return res;
}

#ifdef CONFIG_APP_LITTLEFS_STORAGE_FLASH
static int littlefs_flash_erase(unsigned int id)
{
	const struct flash_area *pfa;
	int rc;

	rc = flash_area_open(id, &pfa);
	if (rc < 0) {
		LOG_ERR("FAIL: unable to find flash area %u: %d\n",
			id, rc);
		return rc;
	}

	LOG_PRINTK("Area %u at 0x%x on %s for %u bytes\n",
		   id, (unsigned int)pfa->fa_off, pfa->fa_dev->name,
		   (unsigned int)pfa->fa_size);

	/* Optional wipe flash contents */
	if (IS_ENABLED(CONFIG_APP_WIPE_STORAGE)) {
		rc = flash_area_erase(pfa, 0, pfa->fa_size);
		LOG_ERR("Erasing flash area ... %d", rc);
	}

	flash_area_close(pfa);
	return rc;
}
#define PARTITION_NODE DT_NODELABEL(lfs1)

#if DT_NODE_EXISTS(PARTITION_NODE)
FS_FSTAB_DECLARE_ENTRY(PARTITION_NODE);
#else /* PARTITION_NODE */
FS_LITTLEFS_DECLARE_DEFAULT_CONFIG(storage);
static struct fs_mount_t lfs_storage_mnt = {
	.type = FS_LITTLEFS,
	.fs_data = &storage,
	.storage_dev = (void *)FIXED_PARTITION_ID(storage_partition),
	.mnt_point = "/lfs",
};
#endif /* PARTITION_NODE */

	struct fs_mount_t *mp =
#if DT_NODE_EXISTS(PARTITION_NODE)
		&FS_FSTAB_ENTRY(PARTITION_NODE)
#else
		&lfs_storage_mnt
#endif
		;

static int littlefs_mount(struct fs_mount_t *mp)
{
	int rc;

	rc = littlefs_flash_erase((uintptr_t)mp->storage_dev);
	if (rc < 0) {
		return rc;
	}

	/* Do not mount if auto-mount has been enabled */
#if !DT_NODE_EXISTS(PARTITION_NODE) ||						\
	!(FSTAB_ENTRY_DT_MOUNT_FLAGS(PARTITION_NODE) & FS_MOUNT_FLAG_AUTOMOUNT)
	rc = fs_mount(mp);
	if (rc < 0) {
		LOG_PRINTK("FAIL: mount id %" PRIuPTR " at %s: %d\n",
		       (uintptr_t)mp->storage_dev, mp->mnt_point, rc);
		return rc;
	}
	LOG_PRINTK("%s mount: %d\n", mp->mnt_point, rc);
#else
	LOG_PRINTK("%s automounted\n", mp->mnt_point);
#endif

	return 0;
}
#endif /* CONFIG_APP_LITTLEFS_STORAGE_FLASH */

#ifdef CONFIG_APP_LITTLEFS_STORAGE_BLK_SDMMC
struct fs_littlefs lfsfs;
static struct fs_mount_t __mp = {
	.type = FS_LITTLEFS,
	.fs_data = &lfsfs,
	.flags = FS_MOUNT_FLAG_USE_DISK_ACCESS,
};
struct fs_mount_t *mp = &__mp;

static int littlefs_mount(struct fs_mount_t *mp)
{
	static const char *disk_mount_pt = "/"CONFIG_SDMMC_VOLUME_NAME":";
	static const char *disk_pdrv = CONFIG_SDMMC_VOLUME_NAME;

	mp->storage_dev = (void *)disk_pdrv;
	mp->mnt_point = disk_mount_pt;

	return fs_mount(mp);
}
#endif /* CONFIG_APP_LITTLEFS_STORAGE_BLK_SDMMC */


void file_sys_create_files (void) {
        if (fs_mkdir("/lfs/sys_logs") == -17) {
            return;
        }
        int ret;

        struct fs_file_t file;

        fs_file_t_init(&file);
        ret = fs_open(&file, "/lfs/sys_logs/log1.json", FS_O_RDWR | FS_O_CREATE);
        ret = fs_write(&file, json_data, json_data_len);
        ret = fs_close(&file);

        fs_file_t_init(&file);
        ret = fs_open(&file, "/lfs/sys_logs/log2.txt", FS_O_RDWR | FS_O_CREATE);
        ret = fs_write(&file, error_data1, error_data1_len);
        ret = fs_close(&file);

        fs_file_t_init(&file);
        ret = fs_open(&file, "/lfs/sys_logs/log3.txt", FS_O_RDWR | FS_O_CREATE);
        ret = fs_write(&file, error_data2, error_data2_len);
        ret = fs_close(&file);
}

void file_sys_rm_files (void) {
    fs_unlink("/lfs/sys_logs/log1.json");
    fs_unlink("/lfs/sys_logs/log2.txt");
    fs_unlink("/lfs/sys_logs/log3.txt");
    fs_unlink("/lfs/sys_logs");
}

int file_sys_init(void)
{
	struct fs_statvfs sbuf;
	int rc;

	LOG_PRINTK("Sample program to r/w files on littlefs\n");

	rc = littlefs_mount(mp);

	if (rc < 0) {
		return rc;
	}

	rc = fs_statvfs(mp->mnt_point, &sbuf);
	if (rc < 0) {
		LOG_PRINTK("FAIL: statvfs: %d\n", rc);
		return rc;
	}

	LOG_PRINTK("%s: bsize = %lu ; frsize = %lu ;"
		   " blocks = %lu ; bfree = %lu\n",
		   mp->mnt_point,
		   sbuf.f_bsize, sbuf.f_frsize,
		   sbuf.f_blocks, sbuf.f_bfree);

	rc = lsdir(mp->mnt_point);
	if (rc < 0) {
		LOG_PRINTK("FAIL: lsdir %s: %d\n", mp->mnt_point, rc);
		return rc;
	}

        return rc;

}

void littlefs_unmount(void) {
    int rc = fs_unmount(mp);
}
```

## src/file_sys.h
```c
#ifndef FILE_H 
#define FILE_H

int lsdir(const char *path);

int file_sys_init(void);

void littlefs_unmount(void);

void file_sys_create_files (void);

void file_sys_rm_files (void);

#endif
```

## src/gatt_cb.c
```c
#include <zephyr/bluetooth/bluetooth.h>
#include <zephyr/bluetooth/conn.h>
#include <zephyr/bluetooth/uuid.h>
#include <zephyr/bluetooth/gatt.h>
#include <zephyr/bluetooth/hci.h>
#include <zephyr/sys/printk.h>
#include <zephyr/kernel.h>

#define VAL_MAX_LEN 512

/*
 * Characteristic cb function called on write request
 * Used to select the path for the file to be read by the read_file characteristic 
 *
 * conn: The connection that is requesting to read
 * attr: The attribute that's being written
 * buf: Buffer with the data to write
 * len: Number of bytes in the buffer
 * offset: Offset to start writing from
 * flags: ?
 *
 * returns: number of bytes written, or BT_GATT_ERR() with ATT error code
 */
ssize_t gatt_cb_char_write (struct bt_conn *conn, struct bt_gatt_attr *attr,
			 const void *buf, uint16_t len, uint16_t offset,
			 uint8_t flags)
{
    uint8_t *char_value = attr->user_data;

    if (offset + len > VAL_MAX_LEN) 
        return BT_GATT_ERR(BT_ATT_ERR_INVALID_OFFSET);

    printk("Writing %d bytes to characteristic... \n", len);
    printk("\n");

    char file_path[VAL_MAX_LEN];
    memcpy(file_path, buf, len);
    file_path[len] = '\0'; 
    len++;

    printk("Value written: %s \n", file_path);

    memcpy(char_value + offset, file_path, len);

    return len;
}

/*
 * Characteristic cb function called on read request
 *
 * conn: The connection that is requesting to read
 * attr: The attribute that's being read
 * buf: Buffer to place the read result in
 * len: Length of data to read
 * offset: Offset to start reading from
 *
 * returns: number of bytes read, or BT_GATT_ERR() with ATT error code
 */
ssize_t gatt_cb_char_read (struct bt_conn *conn, const struct bt_gatt_attr *attr,
			void *buf, uint16_t len, uint16_t offset)
{
    const char *char_value = attr->user_data; 

    printk("Reading characteristic... \n");
    printk("\n");
    return bt_gatt_attr_read(conn, attr, buf, len, offset, char_value,
                             strlen(char_value));
}
```

## src/gatt_cb.h
```c
#ifndef GATT_CALLBACKS_H
#define GATT_CALLBACKS_H

ssize_t gatt_cb_char_write (struct bt_conn *conn, struct bt_gatt_attr *attr,
			 const void *buf, uint16_t len, uint16_t offset,
			 uint8_t flags);

ssize_t gatt_cb_char_read (struct bt_conn *conn, const struct bt_gatt_attr *attr,
			void *buf, uint16_t len, uint16_t offset);

int gatt_cb_read_from_buffer(char* buffer, int len);

#endif
```

## src/gatt_serv.c
```c
#include <zephyr/bluetooth/gatt.h>
#include "gatt_cb.h"
#include "transfer_buffer.h"

#define MAX_ATTR_VAL_SIZE 512

/*
 * Service attribute identifier
*/
#define BT_UUID_CUSTOM_SERVICE_VAL \
	BT_UUID_128_ENCODE(0x00000001,0x1000,0x2000,0x3000,0x111122223333)

static struct bt_uuid_128 serv_attr_uuid = BT_UUID_INIT_128(
	BT_UUID_CUSTOM_SERVICE_VAL);

/*
 * Charactaristic attribute identifiers
*/
static struct bt_uuid_128 file_select_attr_uuid = BT_UUID_INIT_128(
	BT_UUID_128_ENCODE(0x12345678, 0x1234, 0x5678, 0x1234, 0x56789abcdef1));

static struct bt_uuid_128 file_read_attr_uuid = BT_UUID_INIT_128(
	BT_UUID_128_ENCODE(0x12345678, 0x1234, 0x5678, 0x1234, 0x56789abcdef2));

/*
 * Notification subscription callback
*/
static uint8_t is_notifying;
static void file_read_ccc_changed (const struct bt_gatt_attr *attr, uint16_t value) {
    is_notifying = value;
}

static uint8_t char_test_val[21] = {'R', 'A', 'N', 'D', 'O', 'M', ':', ')'};

/* 
 * Service definition 
*/
BT_GATT_SERVICE_DEFINE(data_transfer_service,

    BT_GATT_PRIMARY_SERVICE(&serv_attr_uuid),

    /* File selecting characteristic */
    BT_GATT_CHARACTERISTIC(&file_select_attr_uuid.uuid,
                           BT_GATT_CHRC_WRITE | BT_GATT_CHRC_READ, BT_GATT_PERM_WRITE | BT_GATT_PERM_READ,
                            gatt_cb_char_read, gatt_cb_char_write, char_test_val),

    /* File reading characteristic */
    BT_GATT_CHARACTERISTIC(&file_read_attr_uuid.uuid,
                           BT_GATT_CHRC_NOTIFY, BT_GATT_PERM_NONE, 
                           NULL, NULL, NULL),
    BT_GATT_CCC(file_read_ccc_changed, BT_GATT_PERM_READ | BT_GATT_PERM_WRITE),
);

struct TransferBuffer transfer_buffer = {
    .buffer = NULL,
    .size = 0,
    .position = 0
};

/* 
 * Condition for starting to transfer data
*/
bool gatt_serv_is_transfer_ready (void) {
    bool is_file_path_set = data_transfer_service.attrs[2].user_data != NULL;
    return is_notifying && is_file_path_set;
}

int gatt_serv_load_transfer_data (void) {
    int rc = transfer_buffer_load_file(&transfer_buffer, data_transfer_service.attrs[2].user_data);
    //bt_gatt_notify(NULL, &data_transfer_service.attrs[4], &transfer_buffer->size, sizeof(transfer_buffer->size));
    return rc;
}

int gatt_serv_send_packet (void) {
    char data_packet[20];
    
    int bytes_read = transfer_buffer_read(&transfer_buffer, &data_packet, 20); 
    int rc = 0;


    if (bytes_read == -1) {
        memset(&data_packet, '0', 20);
        is_notifying = false;
        bytes_read = 20;

        transfer_buffer.position = 0;
        rc = -1;
        //return rc;
    }

    bt_gatt_notify(NULL, &data_transfer_service.attrs[4], &data_packet, bytes_read);
    return rc;
}
```

## src/gatt_serv.h
```c
#ifndef GATT_SERVICE_H
#define GATT_SERVICE_H

/*
 * Condition for a client requesting datatransfer.
 */
bool gatt_serv_is_transfer_ready (void);

/*
 * Loads data from filepath given by file_select_attr to the transfer_buffer.
 */
int gatt_serv_load_transfer_data (void);

/*
 * Send 20 bytes of data from transfer_buffer at current transfer_buffer.position 
 * to client and increment transfer_buffer.position.  
 */
int gatt_serv_send_packet (void);

#endif
```

## src/transfer_buffer.c
```c
#include <string.h>
#include <sys/types.h>
#include <zephyr/sys/printk.h>
#include <zephyr/fs/fs.h>
#include <zephyr/kernel.h>
#include "transfer_buffer.h"

void transfer_buffer_clear(struct TransferBuffer* transfer_buffer) {
    transfer_buffer->size = 0;
    transfer_buffer->position = 0;
    transfer_buffer->buffer = NULL;
}

int transfer_buffer_load_file (struct TransferBuffer* transfer_buffer, char* file_path) {

    if (transfer_buffer->size != 0) {
        k_free(transfer_buffer->buffer);
    }

    int rc;
    struct fs_dirent entry;
    rc = fs_stat(file_path, &entry);
    if (rc) {
        transfer_buffer_clear(transfer_buffer);
        return rc;
    }
    size_t file_size = entry.size;


    struct fs_file_t file;
    fs_file_t_init(&file);


    rc = fs_open(&file, file_path, FS_O_READ);
    if (rc) { 
        transfer_buffer_clear(transfer_buffer);
        return rc;
    }

    transfer_buffer->buffer = k_malloc(file_size);

    rc = fs_read(&file, transfer_buffer->buffer, file_size);
    if (rc < 0) {
        transfer_buffer_clear(transfer_buffer);
        return rc;
    }

    transfer_buffer->size = file_size;

    rc = fs_close(&file);
    if (rc) {
        transfer_buffer_clear(transfer_buffer);
        return rc;
    }

    return 0;
}

bool transfer_buffer_is_at_end (struct TransferBuffer* transfer_buffer) {
    return transfer_buffer->size == transfer_buffer->position;
}

int transfer_buffer_read (struct TransferBuffer* transfer_buffer, char* write_buffer, size_t read_len) {

    if (transfer_buffer_is_at_end(transfer_buffer))
        return -1;

    int buffer_len = transfer_buffer->size;
    int offset = transfer_buffer->position;

    if (buffer_len < offset + read_len) 
        read_len = buffer_len - offset;

    memcpy(write_buffer, &transfer_buffer->buffer[offset], read_len);

    transfer_buffer->position += read_len;

    return read_len;
}
```

## src/transfer_buffer.h
```c
#ifndef FILE_BUFFER_H 
#define FILE_BUFFER_H

/*
 * A simple databuffer that can be iterated through (manually right now make it
 * automatic in the future it's easy but I didn't do it cuz I'm a stupid) :-). 
*/

struct TransferBuffer {
    char* buffer;
    ssize_t size;
    ssize_t position;
};

int transfer_buffer_load_file (struct TransferBuffer* transfer_buffer, char* path);

/*
 * Read a number of bytes from the current position. 
*/
int transfer_buffer_read (struct TransferBuffer* transfer_buffer, char* write_buffer, size_t read_len);

bool transfer_buffer_is_at_end (struct TransferBuffer* transfer_buffer);

#endif
```
